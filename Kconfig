## Kconfig
```kconfig
DT_COMPAT_ZMK_BEHAVIOR_SENSOR_ROTATE_KEY_POS := zmk,behavior-sensor-rotate-key-pos
DT_COMPAT_ZMK_BEHAVIOR_MOUSE_SCROLL_STEP := zmk,behavior-mouse-scroll-step

config ZMK_BEHAVIOR_SENSOR_ROTATE_KEY_POS
    bool
    default $(dt_compat_enabled,$(DT_COMPAT_ZMK_BEHAVIOR_SENSOR_ROTATE_KEY_POS))

config ZMK_BEHAVIOR_MOUSE_SCROLL_STEP
    bool
    depends on ZMK_POINTING
    default $(dt_compat_enabled,$(DT_COMPAT_ZMK_BEHAVIOR_MOUSE_SCROLL_STEP))
```

## dts/bindings/behaviors/zmk,behavior-mouse-scroll-step.yaml
```yaml
# Copyright (c) 2026 Tergo Teclados
# SPDX-License-Identifier: MIT

description: Immediate single-step mouse scroll behavior compatible with ZMK Studio and rotary encoders

compatible: "zmk,behavior-mouse-scroll-step"

include: zero_param.yaml

properties:
  scroll-x:
    type: int
    default: 0
    description: Horizontal scroll delta per trigger (positive = right, negative = left).
  scroll-y:
    type: int
    default: 0
    description: Vertical scroll delta per trigger (positive = up, negative = down).
```

## dts/bindings/behaviors/zmk,behavior-sensor-rotate-key-pos.yaml
```yaml
# Copyright (c) 2026 Tergo Teclados
# SPDX-License-Identifier: MIT

description: Sensor rotate behavior that invokes keymap bindings at given key positions

compatible: "zmk,behavior-sensor-rotate-key-pos"

properties:
  label:
    type: string
    required: false
    deprecated: true
  display-name:
    type: string
    required: false
  "#sensor-binding-cells":
    type: int
    required: true
    const: 2
  tap-ms:
    type: int
    default: 5

sensor-binding-cells:
  - param1
  - param2
```
